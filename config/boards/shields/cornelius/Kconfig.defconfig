## config/boards/shields/cornelius/Kconfig.defconfig
```kconfig
if SHIELD_CORNELIUS_LEFT

config ZMK_KEYBOARD_NAME
    default "Cornelius"

config ZMK_SPLIT_ROLE_CENTRAL
    default y

endif
```

## config/boards/shields/cornelius/Kconfig.shield
```kconfig
config SHIELD_CORNELIUS_LEFT
    def_bool $(shields_list_contains,cornelius_left)
    select ZMK_SPLIT_BLE_ROLE_CENTRAL

config SHIELD_CORNELIUS_RIGHT
    def_bool $(shields_list_contains,cornelius_right)
    select ZMK_SPLIT_BLE_ROLE_PERIPHERAL
```
